## sysdrv/source/buildroot/buildroot-2023.02.6/configs/luckfox_pico_defconfig
```kconfig
BR2_arm=y
BR2_cortex_a7=y
BR2_TOOLCHAIN_EXTERNAL=y
BR2_TOOLCHAIN_EXTERNAL_CUSTOM=y
BR2_TOOLCHAIN_EXTERNAL_PATH="../../../../tools/linux/toolchain/arm-rockchip830-linux-uclibcgnueabihf"
BR2_TOOLCHAIN_EXTERNAL_CUSTOM_PREFIX="arm-rockchip830-linux-uclibcgnueabihf"
BR2_TOOLCHAIN_EXTERNAL_GCC_8=y
BR2_TOOLCHAIN_EXTERNAL_HEADERS_5_10=y
BR2_TOOLCHAIN_EXTERNAL_WCHAR=y
BR2_TOOLCHAIN_EXTERNAL_HAS_SSP=y
BR2_TOOLCHAIN_EXTERNAL_CXX=y
BR2_PRIMARY_SITE="http://sources.buildroot.net"
BR2_OPTIMIZE_3=y
BR2_TARGET_GENERIC_HOSTNAME="luckfox pico"
BR2_TARGET_GENERIC_ISSUE="Welcome to luckfox pico"
BR2_TARGET_GENERIC_ROOT_PASSWD="are20t"
# BR2_TARGET_GENERIC_GETTY is not set
# BR2_ENABLE_LOCALE_PURGE is not set
BR2_SYSTEM_ENABLE_NLS=y
BR2_ROOTFS_OVERLAY="../../../../overlays/buildroot/"
BR2_ROOTFS_POST_BUILD_SCRIPT="../../../../overlays/buildroot/post-build.sh"
BR2_ROOTFS_POST_FAKEROOT_SCRIPT="../../../../overlays/buildroot/post-build.sh"
BR2_PACKAGE_BUSYBOX_SHOW_OTHERS=y
BR2_PACKAGE_PKGCONF=y
BR2_PACKAGE_E2FSPROGS=y
BR2_PACKAGE_E2FSPROGS_RESIZE2FS=y
BR2_PACKAGE_MINICOM=y
BR2_PACKAGE_PYTHON3=y
BR2_PACKAGE_PYTHON_AIOHTTP=y
BR2_PACKAGE_PYTHON_FLASK_LOGIN=y
BR2_PACKAGE_PYTHON_PERIPHERY=y
BR2_PACKAGE_PYTHON_PILLOW=y
BR2_PACKAGE_PYTHON_PIP=y
BR2_PACKAGE_PYTHON_SERIAL=y
BR2_PACKAGE_PYTHON_SIMPLESQLITE=y
BR2_PACKAGE_PYTHON_SMBUS_CFFI=y
BR2_PACKAGE_PYTHON_SPIDEV=y
BR2_PACKAGE_GNUTLS=y
BR2_PACKAGE_SQLITE_ENABLE_FTS3=y
BR2_PACKAGE_DTC=y
BR2_PACKAGE_DTC_PROGRAMS=y
BR2_PACKAGE_CJSON=y
BR2_PACKAGE_LIBCURL=y
BR2_PACKAGE_LIBMODBUS=y
BR2_PACKAGE_LIBNL=y
BR2_PACKAGE_LIBTIRPC=y
BR2_PACKAGE_LIBWEBSOCKETS=y
BR2_PACKAGE_PAHO_MQTT_CPP=y
BR2_PACKAGE_ARGP_STANDALONE=y
BR2_PACKAGE_CMOCKA=y
BR2_PACKAGE_LIBEV=y
BR2_PACKAGE_LIBEVENT=y
BR2_PACKAGE_LIBUCI=y
BR2_PACKAGE_POPT=y
BR2_PACKAGE_CHRONY=y
BR2_PACKAGE_CHRONY_DEBUG_LOGGING=y
BR2_PACKAGE_IPROUTE2=y
BR2_PACKAGE_LRZSZ=y
BR2_PACKAGE_MOSQUITTO=y
# BR2_PACKAGE_MOSQUITTO_BROKER is not set
BR2_PACKAGE_OPENRESOLV=y
BR2_PACKAGE_OPENSSH=y
BR2_PACKAGE_PPPD=y
BR2_PACKAGE_PPTP_LINUX=y
BR2_PACKAGE_SER2NET=y
BR2_PACKAGE_UQMI=y
BR2_PACKAGE_BASH=y
BR2_PACKAGE_BASH_LOADABLE_EXAMPLES=y
BR2_PACKAGE_DIALOG=y
BR2_PACKAGE_TIME=y
BR2_PACKAGE_YTREE=y
BR2_PACKAGE_HTOP=y
BR2_PACKAGE_NANO=y
BR2_PACKAGE_HOST_DTC=y
```
